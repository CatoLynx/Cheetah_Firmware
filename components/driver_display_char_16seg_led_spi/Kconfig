## components/driver_display_char_16seg_led_spi/Kconfig
```kconfig
menu "16-segment LED Configuration"

config 16SEG_LED_SPI_CLK_FREQ
    int "SPI Clock Frequency (Hz)"
    default 1000000
    help
        Frequency for SPI clock (in Hz)

config 16SEG_LED_DATA_IO
    int "Data GPIO"
    default 0
    help
        GPIO pin for shift register data

config 16SEG_LED_CLOCK_IO
    int "Clock GPIO"
    default 0
    help
        GPIO pin for shift register clock

config 16SEG_LED_LATCH_IO
    int "Latch GPIO"
    default 0
    help
        GPIO pin for shift register latch

config 16SEG_LED_LATCH_INV
    bool "Latch GPIO active-low"
    default false
    help
        Latch GPIO active-low or active-high

config 16SEG_LED_LATCH_PULSE_LENGTH
    int "Latch pulse length [µs]"
    default 1
    help
        Pulse length of the latch pulse, in microseconds

config 16SEG_LED_USE_ENABLE
    bool "Use enable"
    default false
    help
        Enable pin is present

config 16SEG_LED_EN_IO
    depends on 16SEG_LED_USE_ENABLE
    int "Enable GPIO"
    default 0
    help
        GPIO pin for shift register output enable

config 16SEG_LED_EN_INV
    depends on 16SEG_LED_USE_ENABLE
    bool "Enable GPIO active-low"
    default false
    help
        Output enable GPIO active-low or active-high

config 16SEG_LED_USE_DP_DATA
    bool "Send extra decimal point data"
    default false
    help
        Send extra decimal point data mixed in with the character data

config 16SEG_LED_DP_DATA_INTERVAL
    depends on 16SEG_LED_USE_DP_DATA
    int "Decimal point data interval"
    default 8
    help
        Send a packet of decimal point data every n characters

endmenu
```

## components/driver_display_char_16seg_led_ws281x/Kconfig
```kconfig
menu "16-segment WS281x Configuration"

config 16SEG_WS281X_DATA_IO
    int "Data GPIO"
    default 0
    help
        GPIO Pin for LED data

choice 16SEG_WS281X_SPI_HOST
    bool "SPI Host"
    default 16SEG_WS281X_SPI_HOST_VSPI

    config 16SEG_WS281X_SPI_HOST_VSPI
        bool "VSPI"
    
    config 16SEG_WS281X_SPI_HOST_HSPI
        bool "HSPI"
endchoice

endmenu
```

## components/driver_display_char_16seg_led_ws281x_hybrid/Kconfig
```kconfig
menu "16-segment WS281x Hybrid Configuration"

config 16SEG_WS281X_HYBRID_UPPER_DATA_IO
    int "Upper data GPIO"
    default 0
    help
        GPIO Pin for upper LED data

config 16SEG_WS281X_HYBRID_LOWER_DATA_IO
    int "Lower data GPIO"
    default 0
    help
        GPIO Pin for lower LED data

choice 16SEG_WS281X_HYBRID_UPPER_SPI_HOST
    bool "Upper SPI Host"
    default 16SEG_WS281X_HYBRID_UPPER_SPI_HOST_VSPI

    config 16SEG_WS281X_HYBRID_UPPER_SPI_HOST_VSPI
        bool "VSPI"
    
    config 16SEG_WS281X_HYBRID_UPPER_SPI_HOST_HSPI
        bool "HSPI"
endchoice

choice 16SEG_WS281X_HYBRID_LOWER_SPI_HOST
    bool "Lower SPI Host"
    default 16SEG_WS281X_HYBRID_LOWER_SPI_HOST_VSPI

    config 16SEG_WS281X_HYBRID_LOWER_SPI_HOST_VSPI
        bool "VSPI"
    
    config 16SEG_WS281X_HYBRID_LOWER_SPI_HOST_HSPI
        bool "HSPI"
endchoice

config 16SEG_WS281X_HYBRID_UPPER_LOWER_SPLIT_POS
    int "Split point between upper and lower LEDs"
    default 0
    help
        First LED index of the lower half of the display

endmenu
```

## components/driver_display_char_ibis/Kconfig
```kconfig
menu "IBIS Configuration"

choice IBIS_TELEGRAM_TYPE
    bool "Telegram type"
    default IBIS_TELEGRAM_TYPE_DS009

    config IBIS_TELEGRAM_TYPE_DS009
        bool "DS009"
endchoice

config IBIS_ADDR
    int "Display Address"
    default 1
    help
        Address of display, if telegram type requires it

config IBIS_TX_IO
    int "Tx GPIO"
    default 0
    help
        GPIO pin for data transmitted to display

config IBIS_TX_INVERTED
    bool "Tx Inverted"
    default false
    help
        Whether to invert Tx pin logic

choice IBIS_UART
    bool "UART to use"
    default IBIS_UART_1

    config IBIS_UART_0
        bool "UART0"

    config IBIS_UART_1
        bool "UART1"

    config IBIS_UART_2
        bool "UART2"
endchoice

config IBIS_TX_BUF_SIZE
    int "Tx buffer size in bytes"
    default 256
    help
        UART transmit buffer size. Set to 0 to disable buffer and block while sending data. Otherwise, must be greater that UART_FIFO_LEN.

config IBIS_HAS_WS281X_BACKLIGHT
    bool "Display has WS281x backlight"
    help
        If set, display has RGB backlight using WS281x LEDs

config IBIS_WS281X_DATA_IO
    depends on IBIS_HAS_WS281X_BACKLIGHT
    int "WS281x Data GPIO"
    default 0
    help
        GPIO Pin for WS281x LED data

config IBIS_WS281X_NUM_LEDS
    depends on IBIS_HAS_WS281X_BACKLIGHT
    int "Number of WS281x LEDs"
    default 1
    help
        How many WS281x LEDs make up the backlight

choice IBIS_WS281X_SPI_HOST
    depends on IBIS_HAS_WS281X_BACKLIGHT
    bool "WS281x SPI Host"
    default IBIS_WS281X_SPI_HOST_VSPI

    config IBIS_WS281X_SPI_HOST_VSPI
        bool "VSPI"
    
    config IBIS_WS281X_SPI_HOST_HSPI
        bool "HSPI"
endchoice

choice IBIS_WS281X_COLOR_ORDER
    depends on IBIS_HAS_WS281X_BACKLIGHT
    bool "WS281x color order"
    default IBIS_WS281X_COLOR_ORDER_GRB

    config IBIS_WS281X_COLOR_ORDER_GRB
        bool "GRB"
    
    config IBIS_WS281X_COLOR_ORDER_BRG
        bool "BRG"
endchoice

endmenu
```

## components/driver_display_char_segment_lcd_spi/Kconfig
```kconfig
menu "Character-based Segment LCD Configuration"

config CSEG_LCD_SPI_CLK_FREQ
    int "SPI Clock Frequency (Hz)"
    default 1000000
    help
        Frequency for SPI clock (in Hz)

config CSEG_LCD_DATA_IO
    int "Data GPIO"
    default 0
    help
        GPIO pin for shift register data

config CSEG_LCD_CLOCK_IO
    int "Clock GPIO"
    default 0
    help
        GPIO pin for shift register clock

config CSEG_LCD_LATCH_IO
    int "Latch GPIO"
    default 0
    help
        GPIO pin for shift register latch

config CSEG_LCD_FRCLK_IO
    int "Frame Clock GPIO"
    default 0
    help
        GPIO pin for LCD frame clock (AC signal)

config CSEG_LCD_FRCLK_FREQ
    int "Frame Clock Frequency (Hz)"
    default 0
    help
        Frequency for LCD frame clock (in Hz, AC signal)


config CSEG_LCD_LATCH_INV
    bool "Latch GPIO active-low"
    default false
    help
        Latch GPIO active-low or active-high


config CSEG_LCD_LATCH_PULSE_LENGTH
    int "Latch pulse length [µs]"
    default 1
    help
        Pulse length of the latch pulse, in microseconds


config CSEG_LCD_SEPARATE_OUTPUTS_PER_LINE
    bool "Use latch addressing"
    default false
    help
        Allow controlling multiple LCD buses by outputting a row address to select which row to latch

config CSEG_LCD_LATCH_A0_IO
    depends on CSEG_LCD_SEPARATE_OUTPUTS_PER_LINE
    int "Latch address A0 GPIO"
    default 0
    help
        GPIO pin for latch address bit A0

config CSEG_LCD_LATCH_A1_IO
    depends on CSEG_LCD_SEPARATE_OUTPUTS_PER_LINE
    int "Latch address A1 GPIO"
    default 0
    help
        GPIO pin for latch address bit A1

config CSEG_LCD_LATCH_A2_IO
    depends on CSEG_LCD_SEPARATE_OUTPUTS_PER_LINE
    int "Latch address A2 GPIO"
    default 0
    help
        GPIO pin for latch address bit A2


config CSEG_LCD_USE_ENABLE
    bool "Use enable"
    default false
    help
        Enable pin is present

config CSEG_LCD_EN_IO
    depends on CSEG_LCD_USE_ENABLE
    int "Enable GPIO"
    default 0
    help
        GPIO pin for shift register output enable

config CSEG_LCD_EN_INV
    depends on CSEG_LCD_USE_ENABLE
    bool "Enable GPIO active-low"
    default false
    help
        Output enable GPIO active-low or active-high


config CSEG_LCD_LATCH_INDICATOR_IO
    depends on DISPLAY_LINE_FLAGS_INDICATOR_LIGHT
    int "Indicator latch GPIO"
    default 0
    help
        GPIO pin for indicator latch

config CSEG_LCD_LATCH_INDICATOR_INV
    depends on DISPLAY_LINE_FLAGS_INDICATOR_LIGHT
    bool "Indicator latch GPIO active-low"
    default false
    help
        Indicator latch GPIO active-low or active-high

choice CSEG_LCD_FONT
    bool "LCD type / font"

    config CSEG_LCD_FONT_GV07
        bool "GV07"

    config CSEG_LCD_FONT_SAF_MOSAIC_20
        bool "SaF MOSAIC 20"
endchoice

choice CSEG_LCD_SPI_HOST
    bool "SPI Host"
    default CSEG_LCD_SPI_HOST_VSPI

    config CSEG_LCD_SPI_HOST_VSPI
        bool "VSPI"
    
    config CSEG_LCD_SPI_HOST_HSPI
        bool "HSPI"
endchoice

choice CSEG_LCD_SPI_MODE
    bool "SPI Mode"
    default CSEG_LCD_SPI_MODE_0

    config CSEG_LCD_SPI_MODE_0
        bool "Mode 0 (CPOL=0, CPHA=0)"

    config CSEG_LCD_SPI_MODE_1
        bool "Mode 1 (CPOL=0, CPHA=1)"

    config CSEG_LCD_SPI_MODE_2
        bool "Mode 2 (CPOL=1, CPHA=0)"

    config CSEG_LCD_SPI_MODE_3
        bool "Mode 3 (CPOL=1, CPHA=1)"
endchoice

endmenu
```

## components/driver_display_flipdot/Kconfig
```kconfig
menu "LAWO ALUMA Flipdot Configuration"

config ALUMA_PANEL_WIDTH
    int "Panel Width"
    default 28
    help
        Width of each flipdot panel

config ALUMA_NUM_PANELS
    int "Number of panels"
    default 1
    help
        Total number of flipdot panels connected

endmenu
```

## components/driver_display_flipdot_aesco_saflap/Kconfig
```kconfig
menu "AESCO SAFLAP Flipdot Configuration"

config SAFLAP_NUM_PANELS_X
    int "Number of panels in X direction"
    default 5
    help
        Total number of flipdot panels connected in X direction

config SAFLAP_NUM_PANELS_Y
    int "Number of panels in Y direction"
    default 3
    help
        Total number of flipdot panels connected in Y direction

config SAFLAP_DATA_IO
    int "Data GPIO"
    default 0
    help
        GPIO pin for sending data to the display

config SAFLAP_DATA_IO_INVERT
    bool "Data GPIO Invert"
    default 0
    help
        Invert data GPIO pin

endmenu
```

## components/driver_display_flipdot_brose/Kconfig
```kconfig
menu "BROSE Flipdot Configuration"

config BROSE_PANEL_WIDTH
    int "Panel Width"
    default 28
    help
        Width of each flipdot panel

config BROSE_NUM_PANELS
    int "Number of panels"
    default 1
    help
        Total number of flipdot panels connected

config BROSE_FLIP_PULSE_WIDTH
    int "Flip pulse width in microseconds"
    default 350
    help
        Pixel flip impulse length in microseconds

config BROSE_FLIP_PAUSE_LENGTH
    int "Flip pause length in microseconds"
    default 350
    help
        Pixel flip pause length in microseconds

config BROSE_RD_EN_R_IO
    int "Row driver enable reset GPIO"
    default 0
    help
        GPIO pin for enabling the row driver for resetting pixels

config BROSE_RD_EN_S_IO
    int "Row driver enable set GPIO"
    default 0
    help
        GPIO pin for enabling the row driver for setting pixels

config BROSE_RD_A0_IO
    int "Row driver address bit 0 GPIO"
    default 0
    help
        GPIO pin for address bit 0 of the row drivers

config BROSE_RD_A1_IO
    int "Row driver address bit 1 GPIO"
    default 0
    help
        GPIO pin for address bit 1 of the row drivers

config BROSE_RD_A2_IO
    int "Row driver address bit 2 GPIO"
    default 0
    help
        GPIO pin for address bit 2 of the row drivers

config BROSE_PAN_E_IO
    int "Panel enable GPIO"
    default 0
    help
        GPIO pin for the panel enable signal

config BROSE_PAN_CS_IO
    int "Panel colour select GPIO"
    default 0
    help
        GPIO pin for the panel colour select signal

config BROSE_COL_A0_IO
    int "Column driver address bit 0 GPIO"
    default 0
    help
        GPIO pin for address bit 0 for the column drivers

config BROSE_COL_A1_IO
    int "Column driver address bit 1 GPIO"
    default 0
    help
        GPIO pin for address bit 1 for the column drivers

config BROSE_COL_A2_IO
    int "Column driver address bit 2 GPIO"
    default 0
    help
        GPIO pin for address bit 2 for the column drivers

config BROSE_COL_B0_IO
    int "Column driver address bit 3 GPIO"
    default 0
    help
        GPIO pin for address bit 3 for the column drivers

config BROSE_COL_B1_IO
    int "Column driver address bit 4 GPIO"
    default 0
    help
        GPIO pin for address bit 4 for the column drivers

endmenu
```

## components/driver_display_led/Kconfig
```kconfig
menu "Shift Register LED Matrix Configuration"

config SR_LED_MATRIX_WIDTH
    int "Chain Length"
    default 32
    help
        Total length (width) of all chained LED modules

config SR_LED_MATRIX_NUM_ROWS
    int "Number of rows"
    default 8
    help
        Number of separate rows in the display

config SR_LED_MATRIX_DATA_IO
    int "Data GPIO"
    default 0
    help
        GPIO pin for shift register data

config SR_LED_MATRIX_CLK_IO
    int "Clock GPIO"
    default 0
    help
        GPIO pin for shift register clock

config SR_LED_MATRIX_LATCH_IO
    int "Latch GPIO"
    default 0
    help
        GPIO pin for shift register latch

config SR_LED_MATRIX_EN_IO
    int "Enable GPIO"
    default 0
    help
        GPIO pin for shift register output enable



config SR_LED_MATRIX_ROW_ADDR_USE_LATCH
    bool "Use row address latch"
    default false
    help
        Row address latch pin is present

choice SR_LED_MATRIX_ROW_ADDR_SIZE
    bool "Row address size"
    default SR_LED_MATRIX_ROW_ADDR_SIZE_3BIT

    config SR_LED_MATRIX_ROW_ADDR_SIZE_3BIT
        bool "3 Bit"
    
    config SR_LED_MATRIX_ROW_ADDR_SIZE_4BIT
        bool "4 Bit"
    
    config SR_LED_MATRIX_ROW_ADDR_SIZE_5BIT
        bool "5 Bit"
endchoice

config SR_LED_MATRIX_ROW_A0_IO
    int "Row address bit 0 GPIO"
    default 0
    help
        GPIO pin for row address bit 0

config SR_LED_MATRIX_ROW_A1_IO
    int "Row address bit 1 GPIO"
    default 0
    help
        GPIO pin for row address bit 1

config SR_LED_MATRIX_ROW_A2_IO
    int "Row address bit 2 GPIO"
    default 0
    help
        GPIO pin for row address bit 2

config SR_LED_MATRIX_ROW_A3_IO
    depends on SR_LED_MATRIX_ROW_ADDR_SIZE_4BIT || SR_LED_MATRIX_ROW_ADDR_SIZE_5BIT
    int "Row address bit 3 GPIO"
    default 0
    help
        GPIO pin for row address bit 3

config SR_LED_MATRIX_ROW_A4_IO
    depends on SR_LED_MATRIX_ROW_ADDR_SIZE_5BIT
    int "Row address bit 4 GPIO"
    default 0
    help
        GPIO pin for row address bit 4

config SR_LED_MATRIX_ROW_ADDR_LATCH_IO
    depends on SR_LED_MATRIX_ROW_ADDR_USE_LATCH
    int "Row address latch GPIO"
    default 0
    help
        GPIO pin for row address latch



config SR_LED_MATRIX_DATA_INV
    bool "Data GPIO active-low"
    default false
    help
        Data GPIO active-low or active-high

config SR_LED_MATRIX_CLK_INV
    bool "Clock GPIO active-low"
    default false
    help
        Clock GPIO active-low or active-high

config SR_LED_MATRIX_LATCH_INV
    bool "Latch GPIO active-low"
    default false
    help
        Latch GPIO active-low or active-high

config SR_LED_MATRIX_EN_INV
    bool "Enable GPIO active-low"
    default false
    help
        Output enable GPIO active-low or active-high

config SR_LED_MATRIX_ROW_ADDR_INV
    bool "Row address GPIOs active-low"
    default 0
    help
        Row address GPIOs active-low or active-high

config SR_LED_MATRIX_ROW_ADDR_LATCH_INV
    depends on SR_LED_MATRIX_ROW_ADDR_USE_LATCH
    bool "Row address latch GPIO active-low"
    default 0
    help
        Row address latch GPIO active-low or active-high


choice SR_LED_MATRIX_EN_MODE
    bool "Control Mode"
    default SR_LED_MATRIX_EN_MODE_CONTINUOUS

    config SR_LED_MATRIX_EN_MODE_CONTINUOUS
        bool "Keep EN active while shifting in data"
    
    config SR_LED_MATRIX_EN_MODE_PULSED
        bool "Pulse EN after latch"
endchoice

config SR_LED_MATRIX_EN_PULSE_LENGTH
    depends on SR_LED_MATRIX_EN_MODE_PULSED
    int "EN pulse length [µs]"
    default 1
    help
        Pulse length of the enable pulse, in microseconds

config SR_LED_MATRIX_LATCH_PULSE_LENGTH
    int "Latch pulse length [µs]"
    default 1
    help
        Pulse length of the latch pulse, in microseconds

endmenu
```
