## src/Kconfig
```kconfig
menu "Project Configuration"

config PROJ_DEFAULT_HOSTNAME
    string "Default/Fallback Device Hostname"
    default "xatlabs-cheetah"
    help
        This sets the network hostname used by the device if none is stored in NVS.

config PROJ_DEFAULT_AP_SSID
    string "Default/Fallback AP WiFi SSID"
    default "xatLabs Cheetah"
    help
        SSID (network name) to create when STA connection fails, used if none is stored in NVS.

config PROJ_DEFAULT_AP_PASS
    string "Default/Fallback AP WiFi password"
    default ""
    help
        AP WiFi password (WPA or WPA2) to use if none is stored in NVS.
        Leave blank to create an open WiFi.

endmenu


menu "W5500 Ethernet Configuration"

config ETHERNET_ENABLED
    bool "Use W5500 Ethernet"
    default false
    help
        Enable W5500 for Ethernet use

config ETHERNET_MISO_IO
    depends on ETHERNET_ENABLED
    int "MISO GPIO"
    default 0
    help
        GPIO pin for W5500 MISO

config ETHERNET_MOSI_IO
    depends on ETHERNET_ENABLED
    int "MOSI GPIO"
    default 0
    help
        GPIO pin for W5500 MOSI

config ETHERNET_SCLK_IO
    depends on ETHERNET_ENABLED
    int "SCLK GPIO"
    default 0
    help
        GPIO pin for W5500 SCLK

config ETHERNET_CS_IO
    depends on ETHERNET_ENABLED
    int "CS GPIO"
    default 0
    help
        GPIO pin for W5500 CS

config ETHERNET_INT_IO
    depends on ETHERNET_ENABLED
    int "INT GPIO"
    default 0
    help
        GPIO pin for W5500 INT

config ETHERNET_RST_IO
    depends on ETHERNET_ENABLED
    int "RST GPIO"
    default 0
    help
        GPIO pin for W5500 RST

config ETHERNET_PHY_ADDR
    depends on ETHERNET_ENABLED
    int "PHY address"
    default 0
    help
        PHY address for W5500

config ETHERNET_SPI_CLK_FREQ
    depends on ETHERNET_ENABLED
    int "SPI Clock Frequency (Hz)"
    default 1000000
    help
        Frequency for SPI clock (in Hz)

choice ETHERNET_SPI_HOST
    depends on ETHERNET_ENABLED
    bool "SPI Host"
    default ETHERNET_SPI_HOST_VSPI

    config ETHERNET_SPI_HOST_VSPI
        bool "VSPI"
    
    config ETHERNET_SPI_HOST_HSPI
        bool "HSPI"
endchoice

endmenu


menu "Display Configuration"

choice DISPLAY_TYPE
    bool "Display type"
    default DISPLAY_TYPE_PIXEL

    config DISPLAY_TYPE_PIXEL
        bool "Pixel-based display"
    
    config DISPLAY_TYPE_CHARACTER
        bool "Character-based display"
    
    config DISPLAY_TYPE_CHAR_ON_PIXEL
        bool "Character-based display on top of pixel display"
    
    config DISPLAY_TYPE_PIXEL_ON_CHAR
        bool "Pixel-based display on top of character display"
    
    config DISPLAY_TYPE_SELECTION
        bool "Selection-based display"
endchoice

choice DISPLAY_DRIVER
    bool "Display driver"
    default DISPLAY_DRIVER_NONE

    config DISPLAY_DRIVER_NONE
        bool "None"

    config DISPLAY_DRIVER_FLIPDOT_LAWO_ALUMA
        depends on DISPLAY_TYPE_PIXEL
        bool "LAWO ALUMA flipdot (XY10 panels)"

    config DISPLAY_DRIVER_FLIPDOT_BROSE
        depends on DISPLAY_TYPE_PIXEL
        bool "BROSE flipdot"

    config DISPLAY_DRIVER_FLIPDOT_SAFLAP
        depends on DISPLAY_TYPE_PIXEL
        bool "AESCO SAFLAP flipdot"

    config DISPLAY_DRIVER_LED_SHIFT_REGISTER
        depends on DISPLAY_TYPE_PIXEL
        bool "Generic shift-register based LED display"

    config DISPLAY_DRIVER_LED_SHIFT_REGISTER_I2S
        depends on DISPLAY_TYPE_PIXEL
        bool "Generic shift-register based LED display (using I2S peripheral)"

    config DISPLAY_DRIVER_LED_AESYS_I2S
        depends on DISPLAY_TYPE_PIXEL
        bool "aesys LED display (using I2S peripheral)"
        
    config DISPLAY_DRIVER_CHAR_SEG_LCD_SPI
        depends on DISPLAY_TYPE_CHARACTER
        bool "Character-based segmented LCD (using SPI peripheral)"
        
    config DISPLAY_DRIVER_CHAR_16SEG_LED_SPI
        depends on DISPLAY_TYPE_CHARACTER
        bool "16-segment LED (using SPI peripheral)"
        
    config DISPLAY_DRIVER_CHAR_KRONE_9000
        depends on DISPLAY_TYPE_CHARACTER
        bool "KRONE 9000 Split-Flap (using UART peripheral)"
        
    config DISPLAY_DRIVER_CHAR_16SEG_LED_WS281X
        depends on DISPLAY_TYPE_CHARACTER
        bool "16-segment LED (using WS281X)"
        
    config DISPLAY_DRIVER_CHAR_16SEG_LED_WS281X_HYBRID
        depends on DISPLAY_TYPE_CHAR_ON_PIXEL
        bool "16-segment LED (using WS281X) - Hybrid (char-on-pixel)"
        
    config DISPLAY_DRIVER_SEL_KRONE_9000
        depends on DISPLAY_TYPE_SELECTION
        bool "KRONE 9000 Split-Flap (using UART peripheral)"
        
    config DISPLAY_DRIVER_SEL_KRONE_8200_PST
        depends on DISPLAY_TYPE_SELECTION
        bool "KRONE 8200 Split-Flap, PST (using UART peripheral)"
endchoice

config DISPLAY_UNIT_BUF_SIZE
    depends on DISPLAY_TYPE_SELECTION
    int "Unit data buffer size"
    default 256
    help
        Size of the data buffer for unit data. Since selection displays are dynamically configured, this should be large enough to cover a large display. One unit is one selection module.

choice DISPLAY_PIX_BUF_TYPE
    depends on DISPLAY_TYPE_PIXEL || DISPLAY_TYPE_CHAR_ON_PIXEL || DISPLAY_TYPE_PIXEL_ON_CHAR
    bool "Pixel frame type"
    default DISPLAY_PIX_BUF_TYPE_1BPP

    config DISPLAY_PIX_BUF_TYPE_1BPP
        bool "1 bit per pixel (black/white)"
    
    config DISPLAY_PIX_BUF_TYPE_8BPP
        bool "8 bits per pixel (greyscale)"
    
    config DISPLAY_PIX_BUF_TYPE_24BPP
        bool "24 bits per pixel (RGB, 8 bits per colour)"
endchoice

config DISPLAY_VIEWPORT_WIDTH_PIXEL
    depends on DISPLAY_TYPE_PIXEL || DISPLAY_TYPE_CHAR_ON_PIXEL || DISPLAY_TYPE_PIXEL_ON_CHAR
    int "Pixel viewport width"
    default 0
    help
        Actual width of the pixel viewport, as seen from the outside, in pixels.

config DISPLAY_VIEWPORT_HEIGHT_PIXEL
    depends on DISPLAY_TYPE_PIXEL || DISPLAY_TYPE_CHAR_ON_PIXEL || DISPLAY_TYPE_PIXEL_ON_CHAR
    int "Pixel viewport height"
    default 0
    help
        Actual height of the pixel viewport, as seen from the outside, in pixels.

config DISPLAY_VIEWPORT_WIDTH_CHAR
    depends on DISPLAY_TYPE_CHARACTER || DISPLAY_TYPE_CHAR_ON_PIXEL || DISPLAY_TYPE_PIXEL_ON_CHAR
    int "Character viewport width"
    default 0
    help
        Actual width of the character viewport, as seen from the outside, in characters.

config DISPLAY_VIEWPORT_HEIGHT_CHAR
    depends on DISPLAY_TYPE_CHARACTER || DISPLAY_TYPE_CHAR_ON_PIXEL || DISPLAY_TYPE_PIXEL_ON_CHAR
    int "Character viewport height"
    default 0
    help
        Actual height of the character viewport, as seen from the outside, in characters.

config DISPLAY_FRAME_WIDTH_PIXEL
    depends on DISPLAY_TYPE_PIXEL || DISPLAY_TYPE_CHAR_ON_PIXEL || DISPLAY_TYPE_PIXEL_ON_CHAR
    int "Pixel frame width"
    default 0
    help
        Internal frame width of the pixel display. Can be larger than the viewport width
        to allow scrolling or other effects.

config DISPLAY_FRAME_HEIGHT_PIXEL
    depends on DISPLAY_TYPE_PIXEL || DISPLAY_TYPE_CHAR_ON_PIXEL || DISPLAY_TYPE_PIXEL_ON_CHAR
    int "Pixel frame height"
    default 0
    help
        Internal frame height of the pixel display. Can be larger than the viewport height
        to allow scrolling or other effects.

config DISPLAY_FRAME_WIDTH_CHAR
    depends on DISPLAY_TYPE_CHARACTER || DISPLAY_TYPE_CHAR_ON_PIXEL || DISPLAY_TYPE_PIXEL_ON_CHAR
    int "Character frame width"
    default 0
    help
        Internal frame width of the character display. Can be larger than the viewport width
        to allow scrolling or other effects.

config DISPLAY_FRAME_HEIGHT_CHAR
    depends on DISPLAY_TYPE_CHARACTER || DISPLAY_TYPE_CHAR_ON_PIXEL || DISPLAY_TYPE_PIXEL_ON_CHAR
    int "Character frame height"
    default 0
    help
        Internal frame height of the character display. Can be larger than the viewport height
        to allow scrolling or other effects.

config DISPLAY_VIEWPORT_OFFSET_X_PIXEL
    depends on DISPLAY_TYPE_PIXEL || DISPLAY_TYPE_CHAR_ON_PIXEL || DISPLAY_TYPE_PIXEL_ON_CHAR
    int "Pixel viewport X offset"
    default 0
    help
        In case the frame width is larger than the pixel display width,
        this specifies the X offset between the viewport and the framebuffer.

config DISPLAY_VIEWPORT_OFFSET_Y_PIXEL
    depends on DISPLAY_TYPE_PIXEL || DISPLAY_TYPE_CHAR_ON_PIXEL || DISPLAY_TYPE_PIXEL_ON_CHAR
    int "Pixel viewport Y offset"
    default 0
    help
        In case the frame height is larger than the pixel display height,
        this specifies the Y offset between the viewport and the framebuffer.

config DISPLAY_VIEWPORT_OFFSET_X_CHAR
    depends on DISPLAY_TYPE_CHARACTER || DISPLAY_TYPE_CHAR_ON_PIXEL || DISPLAY_TYPE_PIXEL_ON_CHAR
    int "Character viewport X offset"
    default 0
    help
        In case the frame width is larger than the character display width,
        this specifies the X offset between the viewport and the framebuffer.

config DISPLAY_VIEWPORT_OFFSET_Y_CHAR
    depends on DISPLAY_TYPE_CHARACTER || DISPLAY_TYPE_CHAR_ON_PIXEL || DISPLAY_TYPE_PIXEL_ON_CHAR
    int "Character viewport Y offset"
    default 0
    help
        In case the frame height is larger than the character display height,
        this specifies the Y offset between the viewport and the framebuffer.

choice DISPLAY_OUTPUT_BUFFER_BASED_ON
    depends on DISPLAY_TYPE_CHAR_ON_PIXEL || DISPLAY_TYPE_PIXEL_ON_CHAR
    bool "Output buffer based on"
    default DISPLAY_OUTPUT_BUFFER_BASED_ON_PIXEL

    config DISPLAY_OUTPUT_BUFFER_BASED_ON_PIXEL
        bool "Output buffer based on pixel buffer"
    
    config DISPLAY_OUTPUT_BUFFER_BASED_ON_CHAR
        bool "Output buffer based on character buffer"
endchoice

config DISPLAY_OUTPUT_WIDTH
    depends on DISPLAY_TYPE_PIXEL || DISPLAY_TYPE_CHARACTER || DISPLAY_TYPE_CHAR_ON_PIXEL || DISPLAY_TYPE_PIXEL_ON_CHAR
    int "Output width"
    default 0
    help
        Output width of the display. Usually the same as the actual width, but can be different
        in case of non-populated columns of pixels/characters or other mapping shenanigans.

config DISPLAY_OUTPUT_HEIGHT
    depends on DISPLAY_TYPE_PIXEL || DISPLAY_TYPE_CHARACTER || DISPLAY_TYPE_CHAR_ON_PIXEL || DISPLAY_TYPE_PIXEL_ON_CHAR
    int "Output height"
    default 0
    help
        Output height of the display. Usually the same as the actual height, but can be different
        in case of non-populated rows of pixels/characters or other mapping shenanigans.

config DISPLAY_USE_PREV_FRAMEBUF
    bool "Use second framebuffer to store the previous frame"
    help
        This allows the display to take advantage of knowing what has changed between the current
        and previous frames, thus enabling a quicker refresh.

config DISPLAY_SHOW_MESSAGES
    depends on DISPLAY_TYPE_CHARACTER || DISPLAY_TYPE_CHAR_ON_PIXEL || DISPLAY_TYPE_PIXEL_ON_CHAR
    bool "Show status messages on display"
    help
        If set, show things like IP address or WiFi info on the display.

config DISPLAY_FONT_BYTES_PER_CHAR
    depends on DISPLAY_TYPE_CHARACTER || DISPLAY_TYPE_CHAR_ON_PIXEL || DISPLAY_TYPE_PIXEL_ON_CHAR
    int "Bytes per character (for font)"
    default 1
    help
        How many bytes of data the font contains per character.

config DISPLAY_FRAMEBUF_BITS_PER_CHAR
    depends on DISPLAY_TYPE_CHARACTER || DISPLAY_TYPE_CHAR_ON_PIXEL || DISPLAY_TYPE_PIXEL_ON_CHAR
    int "Bits per character (for framebuffer size)"
    default 8
    help
        How many bits of data are to be stored per character. Used for framebuffer size calculation.

config DISPLAY_HAS_BRIGHTNESS_CONTROL
    bool "Display has brightness control"
    default false
    help
        Enable brightness control

config DISPLAY_HAS_SHADERS
    depends on DISPLAY_TYPE_PIXEL || DISPLAY_TYPE_CHARACTER || DISPLAY_TYPE_CHAR_ON_PIXEL || DISPLAY_TYPE_PIXEL_ON_CHAR
    bool "Display has shaders (color effects)"
    default false
    help
        Enable shaders (color effects)

config DISPLAY_SHADER_INCLUDE
    depends on DISPLAY_HAS_SHADERS
    string "Shader include filename"
    help
       Filename of the shader include


menu "Quirks"

config DISPLAY_QUIRKS_COMBINING_FULL_STOP
    depends on DISPLAY_TYPE_CHARACTER || DISPLAY_TYPE_CHAR_ON_PIXEL || DISPLAY_TYPE_PIXEL_ON_CHAR
    bool "Combining full stop"
    default false
    help
        A full stop combines with the previous character if possible.

endmenu

endmenu


menu "Fan Configuration"

config FAN_ENABLED
    bool "Use fan"
    default false
    help
        Enable fan control

config FAN_PWM_TIMER_NUM
    depends on FAN_ENABLED
    int "Fan PWM timer number"
    default 0
    help
        LEDC timer number for fan PWM (0 to 3)

config FAN_PWM_CHANNEL_NUM
    depends on FAN_ENABLED
    int "Fan PWM channel number"
    default 0
    help
        LEDC channel number for fan PWM (0 to 7)

config FAN_PWM_GPIO_NUM
    depends on FAN_ENABLED
    int "Fan PWM GPIO number"
    default 0
    help
        GPIO number for fan PWM

config FAN_PWM_FREQ
    depends on FAN_ENABLED
    int "Fan PWM frequency (Hz)"
    default 25000
    help
        PWM frequency for fan PWM

config FAN_SPEED_ADJUST_DELAY
    depends on FAN_ENABLED
    int "Fan speed adjust delay in ms"
    default 100
    help
        How many milliseconds between each fan speed adjustment step. There are 256 steps in total. Minimum is 10.

endmenu
```
