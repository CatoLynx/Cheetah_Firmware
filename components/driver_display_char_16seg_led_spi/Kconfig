## components/driver_display_led_aesys/Kconfig
```kconfig
menu "aesys LED Matrix Configuration"

config AESYS_LED_MATRIX_WIDTH
    int "Chain Length"
    default 32
    help
        Total length (width) of all chained LED modules

config AESYS_LED_MATRIX_NUM_ROWS
    int "Number of rows"
    default 8
    help
        Number of separate rows in the display

config AESYS_LED_MATRIX_DATA_IO
    int "Data GPIO"
    default 0
    help
        GPIO pin for shift register data

config AESYS_LED_MATRIX_CLK_IO
    int "Clock GPIO"
    default 0
    help
        GPIO pin for shift register clock

config AESYS_LED_MATRIX_LATCH_IO
    int "Latch GPIO"
    default 0
    help
        GPIO pin for shift register latch

config AESYS_LED_MATRIX_EN_IO
    int "Enable GPIO"
    default 0
    help
        GPIO pin for shift register output enable

config AESYS_LED_MATRIX_BRT_IO
    int "Ambient Brightness GPIO"
    default 0
    help
        GPIO pin for ambient brightness signal input

config AESYS_LED_MATRIX_FB_IO
    int "Feedback GPIO"
    default 0
    help
        GPIO pin for display content feedback signal input

config AESYS_LED_MATRIX_FB_LATCH_IO
    int "Feedback Latch GPIO"
    default 0
    help
        GPIO pin for display content feedback signal latch output

endmenu
```

## components/driver_display_sel_aeg_splitflap/Kconfig
```kconfig
menu "AEG Split-Flap Configuration (Selection Mode)"

config AEG_SEL_DATA_OUT_IO
    int "Data Output GPIO"
    default 0
    help
        GPIO pin for data output

config AEG_SEL_DATA_IN_IO
    int "Data Input GPIO"
    default 0
    help
        GPIO pin for data input

config AEG_SEL_CLOCK_IO
    int "Clock GPIO"
    default 0
    help
        GPIO pin for clock signal

config AEG_SEL_OUT_LATCH_IO
    int "Output Latch GPIO"
    default 0
    help
        GPIO pin for latch signal for output data

config AEG_SEL_IN_LATCH_IO
    int "Input Latch GPIO"
    default 0
    help
        GPIO pin for latch signal for input data

config AEG_SEL_SET_BUTTON_IO
    int "Set Button GPIO"
    default 0
    help
        GPIO pin for set button

config AEG_SEL_USE_ZACE
    bool "Use ZACE expansion card"
    default false
    help
        If set, the AEG ZACE expansion card will be used to control more split-flap units

config AEG_SEL_ZACE_REG_SEL_A0_IO
    depends on AEG_SEL_USE_ZACE
    int "ZACE Register select A0 GPIO"
    default 0
    help
        GPIO pin for ZACE register selection address bit 0

config AEG_SEL_ZACE_REG_SEL_A1_IO
    depends on AEG_SEL_USE_ZACE
    int "ZACE Register select A1 GPIO"
    default 0
    help
        GPIO pin for ZACE register selection address bit 1

config AEG_SEL_ZACE_REG_SEL_EN_TOP_IO
    depends on AEG_SEL_USE_ZACE
    int "ZACE Register select enable top half GPIO"
    default 0
    help
        GPIO pin for ZACE register selection enable on top half of ZACE card

config AEG_SEL_ZACE_REG_SEL_EN_BOTTOM_IO
    depends on AEG_SEL_USE_ZACE
    int "ZACE Register select enable bottom half GPIO"
    default 0
    help
        GPIO pin for ZACE register selection enable on bottom half of ZACE card

config AEG_SEL_LATCH_PULSE_DURATION
    int "Pulse duration for latches (us)"
    default 1
    help
        Latch pulse duration in us

config AEG_SEL_SPI_CLOCK
    int "SPI clock speed (Hz)"
    default 1000000
    help
        Clock speed in Hz

choice AEG_SEL_SPI_HOST
    bool "SPI Host"
    default AEG_SEL_SPI_HOST_VSPI

    config AEG_SEL_SPI_HOST_VSPI
        bool "VSPI"
    
    config AEG_SEL_SPI_HOST_HSPI
        bool "HSPI"
endchoice

config AEG_SEL_ROTATION_TIMEOUT
    int "Rotation Timeout (ms)"
    default 5000
    help
        How many milliseconds to wait for rotation to complete before stopping any rogue units

endmenu
```

## components/driver_display_sel_krone_9000/Kconfig
```kconfig
menu "KRONE 9000 Split-Flap Configuration (Selection Mode)"

config K9000_SEL_TX_IO
    int "Tx GPIO"
    default 0
    help
        GPIO pin for data transmitted to split-flap modules

config K9000_SEL_RX_IO
    int "Rx GPIO"
    default 0
    help
        GPIO pin for data received from split-flap modules

choice K9000_SEL_UART
    bool "UART to use"
    default K9000_SEL_UART_1

    config K9000_SEL_UART_0
        bool "UART0"

    config K9000_SEL_UART_1
        bool "UART1"

    config K9000_SEL_UART_2
        bool "UART2"
endchoice

config K9000_SEL_RX_BUF_SIZE
    int "Rx buffer size in bytes"
    default 64
    help
        UART receive buffer size. Must be greater that UART_FIFO_LEN.

config K9000_SEL_TX_BUF_SIZE
    int "Tx buffer size in bytes"
    default 256
    help
        UART transmit buffer size. Set to 0 to disable buffer and block while sending data. Otherwise, must be greater that UART_FIFO_LEN.

endmenu
```

## components/i2s_microphone/Kconfig
```kconfig
menu "I2S Microphone"

config I2S_MIC_ENABLED
    bool "Use I2S Microphone"
    default false
    help
        Enable support for I2S Microphone

choice I2S_MIC_PERIPHERAL
    bool "I2S Peripheral"
    depends on I2S_MIC_ENABLED
    default I2S_MIC_PERIPHERAL_I2S0
    
    config I2S_MIC_PERIPHERAL_I2S0
        bool "I2S0"
    
    config I2S_MIC_PERIPHERAL_I2S1
        bool "I2S1"
endchoice

config I2S_MIC_CLK_IO
    int "Clock GPIO"
    depends on I2S_MIC_ENABLED
    default 0

config I2S_MIC_WS_IO
    int "WS GPIO"
    depends on I2S_MIC_ENABLED
    default 0

config I2S_MIC_DATA_IO
    int "Data GPIO"
    depends on I2S_MIC_ENABLED
    default 0

config I2S_MIC_SAMPLE_RATE
    int "Sample Rate"
    depends on I2S_MIC_ENABLED
    default 44100

choice I2S_MIC_SAMPLE_WIDTH
    bool "Sample Width"
    depends on I2S_MIC_ENABLED
    default I2S_MIC_SAMPLE_WIDTH_24BIT
    
    config I2S_MIC_SAMPLE_WIDTH_8BIT
        bool "8 Bit"
    
    config I2S_MIC_SAMPLE_WIDTH_16BIT
        bool "16 Bit"
    
    config I2S_MIC_SAMPLE_WIDTH_24BIT
        bool "24 Bit"
    
    config I2S_MIC_SAMPLE_WIDTH_32BIT
        bool "24 Bit"
endchoice

endmenu
```

## components/input_artnet/Kconfig
```kconfig
menu "ArtNet Receiver"

config ARTNET_PORT
    int "UDP Port to listen on for ArtNet messages"
    default 6454

config ARTNET_RX_BUF_SIZE
    int "Rx buffer size in bytes"
    default 2048

choice ARTNET_FRAME_TYPE
    bool "ArtNet frame type"
    default ARTNET_FRAME_TYPE_24BPP
    
    config ARTNET_FRAME_TYPE_1BPP
        bool "1 bit per pixel (black/white)"
    
    config ARTNET_FRAME_TYPE_8BPP
        bool "8 bits per pixel (greyscale)"
    
    config ARTNET_FRAME_TYPE_24BPP
        bool "24 bits per pixel (RGB, 8 bits per colour)"
endchoice

endmenu
```

## components/input_telegram_bot/Kconfig
```kconfig
menu "Telegram Bot Configuration"

config TG_BOT_POLLING_TIMEOUT
    int "Polling timeout in seconds"
    default 60
    help
        Telegram Bot API polling timeout

config TG_BOT_MESSAGE_LIMIT
    int "Max messages to fetch"
    default 10
    help
        Maximum number of messages to fetch at once from the API

config TG_BOT_FORCE_UPPERCASE
    bool "Force uppercase characters"
    default false

choice TG_BOT_CHARSET_METHOD
    bool "Charset Method"
    default TG_BOT_CHARSET_METHOD_ALLOWED_CHARS_STR

    config TG_BOT_CHARSET_METHOD_ALLOWED_CHARS_STR
        bool "Allowed Characters String"
    
    config TG_BOT_CHARSET_METHOD_DISALLOWED_CHARS_STR
        bool "Disallowed Characters String"

    config TG_BOT_CHARSET_METHOD_ALLOWED_CHARS_RANGE
        bool "Allowed Characters Range"
    
    config TG_BOT_CHARSET_METHOD_DISALLOWED_CHARS_RANGE
        bool "Disallowed Characters Range"
endchoice

config TG_BOT_ALLOWED_CHARACTERS_STR
depends on TG_BOT_CHARSET_METHOD_ALLOWED_CHARS_STR
    string "Allowed Characters String"
    default ""
    help
        All the characters that are allowed for display

config TG_BOT_DISALLOWED_CHARACTERS_STR
depends on TG_BOT_CHARSET_METHOD_DISALLOWED_CHARS_STR
    string "Disallowed Characters String"
    default ""
    help
        All the characters that are allowed for display

config TG_BOT_ALLOWED_CHARACTERS_RANGE_MIN
depends on TG_BOT_CHARSET_METHOD_ALLOWED_CHARS_RANGE
    int "Allowed Characters Range Min"
    default 32

config TG_BOT_ALLOWED_CHARACTERS_RANGE_MAX
depends on TG_BOT_CHARSET_METHOD_ALLOWED_CHARS_RANGE
    int "Allowed Characters Range Max"
    default 127

config TG_BOT_DISALLOWED_CHARACTERS_RANGE_MIN
depends on TG_BOT_CHARSET_METHOD_DISALLOWED_CHARS_RANGE
    int "Disallowed Characters Range Min"
    default 32

config TG_BOT_DISALLOWED_CHARACTERS_RANGE_MAX
depends on TG_BOT_CHARSET_METHOD_DISALLOWED_CHARS_RANGE
    int "Disallowed Characters Range Max"
    default 127

endmenu
```

## components/input_tpm2net/Kconfig
```kconfig
menu "tpm2.net Receiver"

config TPM2NET_PORT
    int "UDP Port to listen on for tpm2.net messages"
    default 65506

config TPM2NET_RX_BUF_SIZE
    int "Rx buffer size in bytes"
    default 2048

choice TPM2NET_FRAME_TYPE
    bool "tpm2.net frame type"
    default TPM2NET_FRAME_TYPE_24BPP
    
    config TPM2NET_FRAME_TYPE_1BPP
        bool "1 bit per pixel (black/white)"
    
    config TPM2NET_FRAME_TYPE_8BPP
        bool "8 bits per pixel (greyscale)"
    
    config TPM2NET_FRAME_TYPE_24BPP
        bool "24 bits per pixel (RGB, 8 bits per colour)"
endchoice

endmenu
```

## components/logging_tcp/Kconfig
```kconfig
menu "TCP Logging Server"

config TCP_LOG_ENABLED
    bool "TCP Logging Server enabled"
    default 0

config TCP_LOG_PORT
    depends on TCP_LOG_ENABLED
    int "TCP Port to listen on"
    default 1337

config TCP_LOG_BACKLOG
    depends on TCP_LOG_ENABLED
    int "Maximum number of pending connections"
    default 5

config TCP_LOG_BUFFER_SIZE
    depends on TCP_LOG_ENABLED
    int "Log message buffer size"
    default 100

config TCP_LOG_KEEPALIVE_IDLE
    depends on TCP_LOG_ENABLED
    int "TCP keep-alive idle time (seconds)"
    default 1
    help
        Keep-alive idle time. In idle time without receiving any data from peer, will send keep-alive probe packet.

config TCP_LOG_KEEPALIVE_INTERVAL
    depends on TCP_LOG_ENABLED
    int "TCP keep-alive interval time (seconds)"
    default 1
    help
        Keep-alive probe packet interval time.

config TCP_LOG_KEEPALIVE_COUNT
    depends on TCP_LOG_ENABLED
    int "TCP keep-alive packet retry send count"
    default 3
    help
        Keep-alive probe packet retry count.

endmenu
```
